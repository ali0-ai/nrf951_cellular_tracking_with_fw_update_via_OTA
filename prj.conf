## CMakeLists.txt
```
# SPDX-License-Identifier: Apache-2.0

cmake_minimum_required(VERSION 3.20.0)

find_package(Zephyr REQUIRED HINTS $ENV{ZEPHYR_BASE})
project(fw_update)

target_sources(app PRIVATE src/main.c)
target_sources_ifdef(CONFIG_GOLIOTH_CELLULAR_PLAYBACK app PRIVATE src/cellular_playback.c)
target_sources_ifdef(CONFIG_GOLIOTH_WIFI_PLAYBACK app PRIVATE src/wifi_playback.c)
target_sources_ifdef(CONFIG_SOC_SERIES_NRF91X app PRIVATE src/cellular_nrf91.c)
```

## Kconfig
```
# Copyright (c) 2021-2025 Golioth, Inc.
# SPDX-License-Identifier: Apache-2.0

configdefault GOLIOTH_LOCATION_CELLULAR
    default y if SOC_SERIES_NRF91X
    default y if GOLIOTH_CELLULAR_PLAYBACK



source "${ZEPHYR_GOLIOTH_FIRMWARE_SDK_MODULE_DIR}/examples/zephyr/common/Kconfig.defconfig"

config APP_LOCATION_GET_INTERVAL
    int "Interval (msec)"
    default 0 if GOLIOTH_CELLULAR_PLAYBACK
    default 5000
    help
      Interval (msec) between requests of location information.

config GOLIOTH_CELLULAR_PLAYBACK
    bool "Cellular playback"
    default y
    depends on DT_HAS_GOLIOTH_CELLULAR_PLAYBACK_ENABLED


if GOLIOTH_CELLULAR_PLAYBACK

config GOLIOTH_PLAYBACK_SPEED_FACTOR
    int "Speed factor"
    default 1000
    help
      Speed of playback.

      1000 means 1x (normal) speed.
      3000 means 3x speed.
      500 means 0.5x speed.

endif # GOLIOTH_CELLULAR_PLAYBACK

source "Kconfig.zephyr"
```

## sample.yaml
```
sample:
  description: Golioth OTA FW Update Sample
  name: fw_update
common:
  tags:
    - golioth
    - location
    - socket
    - goliothd
tests:
  sample.golioth.fw_update:
    harness: pytest
    sysbuild: true
    timeout: 720
    extra_args: EXTRA_CONF_FILE="../common/runtime_settings.conf"
    extra_configs:
      - CONFIG_GOLIOTH_SAMPLE_TWISTER_TEST=y
    platform_allow:
      - esp32_devkitc_wrover/esp32/procpu
      - mimxrt1024_evk
      - nrf52840dk/nrf52840
      - nrf9160dk/nrf9160/ns
  sample.golioth.fw_update.buildonly:
    build_only: true
    sysbuild: true
    platform_allow:
      - rak5010/nrf52840
  sample.golioth.fw_update.native:
    build_only: true
    platform_allow:
      - native_sim
      - native_sim/native/64
  sample.golioth.location:
    platform_allow:
      - esp32_devkitc_wrover/esp32/procpu
      - native_sim
      - native_sim/native/64
      - nrf52840dk/nrf52840
      - nrf9151dk/nrf9151/ns
      - nrf9160dk/nrf9160/ns
  sample.golioth.location.cellular_only:
    extra_configs:
      - CONFIG_GOLIOTH_WIFI_PLAYBACK=n
    platform_allow:
      - native_sim
      - native_sim/native/64
```

## prj.conf
```kconfig
# Application
CONFIG_GOLIOTH_SAMPLE_COMMON=y
CONFIG_GOLIOTH_SAMPLE_HARDCODED_CREDENTIALS=y
CONFIG_LOG_BACKEND_GOLIOTH=n
CONFIG_GOLIOTH_LOCATION=y
# Golioth Firmware SDK with all dependencies
CONFIG_GOLIOTH_FIRMWARE_SDK=y
CONFIG_GOLIOTH_FW_UPDATE=y

CONFIG_FLASH=y
CONFIG_FLASH_MAP=y
CONFIG_STREAM_FLASH=y
CONFIG_IMG_MANAGER=y
CONFIG_IMG_ERASE_PROGRESSIVELY=y







#######################################################
# nRF91xx configurations for Stratus Pro Devices
# General config
CONFIG_HEAP_MEM_POOL_SIZE=4096
CONFIG_NEWLIB_LIBC=y

# Networking
CONFIG_NET_SOCKETS_OFFLOAD=y
CONFIG_NET_IPV6=y
CONFIG_NET_IPV6_NBR_CACHE=n
CONFIG_NET_IPV6_MLD=n

# Increase native TLS socket implementation, so that it is chosen instead of
# offloaded nRF91 sockets
CONFIG_NET_SOCKETS_TLS_PRIORITY=35

# Modem library
CONFIG_NRF_MODEM_LIB=y

# LTE connectivity with network connection manager
CONFIG_NRF_MODEM_LIB_NET_IF=y
CONFIG_NRF_MODEM_LIB_NET_IF_AUTO_START=y
CONFIG_NRF_MODEM_LIB_NET_IF_AUTO_CONNECT=y
CONFIG_NET_CONNECTION_MANAGER=y
CONFIG_NET_CONNECTION_MANAGER_MONITOR_STACK_SIZE=1024

# Increased sysworkq size, due to LTE connectivity
CONFIG_SYSTEM_WORKQUEUE_STACK_SIZE=2048

# Disable options y-selected by NCS for no good reason
CONFIG_MBEDTLS_KEY_EXCHANGE_DHE_PSK_ENABLED=n
CONFIG_MBEDTLS_KEY_EXCHANGE_DHE_RSA_ENABLED=n

# MbedTLS configuration to support p-384 curve. These options
# enable using the MbedTLS built-in support for operations not
# supported by the default nRF Oberon crypto backend
CONFIG_NORDIC_SECURITY_BACKEND=n
CONFIG_MBEDTLS_LEGACY_CRYPTO_C=y

# Generate MCUboot compatible images
# CONFIG_BOOTLOADER_MCUBOOT=y

# Insert Golioth PSK and ID here
CONFIG_GOLIOTH_SAMPLE_PSK_ID="lifesavr-beta@nrf-beta"
CONFIG_GOLIOTH_SAMPLE_PSK="60d0658a8ba596ee02d4d7864fbddbd7"
# SB_CONFIG_BOOTLOADER_MCUBOOT=y
```

## socs/native_64.conf
```kconfig
# Use offloaded sockets using host BSD sockets
CONFIG_ETH_DRIVER=n
CONFIG_ETH_NATIVE_POSIX=n
CONFIG_NET_DRIVERS=y
CONFIG_NET_SOCKETS=y
CONFIG_NET_SOCKETS_OFFLOAD=y
CONFIG_NET_NATIVE_OFFLOADED_SOCKETS=y
CONFIG_HEAP_MEM_POOL_SIZE=1024

# Use embedded libc to use Zephyr's eventfd instead of host eventfd
CONFIG_PICOLIBC=y

# Static networking
CONFIG_NET_CONFIG_LOG_LEVEL_DBG=y
CONFIG_NET_CONFIG_SETTINGS=y
CONFIG_NET_CONFIG_NEED_IPV4=y
CONFIG_NET_CONFIG_MY_IPV4_ADDR="192.0.2.1"
CONFIG_NET_CONFIG_MY_IPV4_GW="192.0.2.2"
CONFIG_NET_CONFIG_PEER_IPV4_ADDR="192.0.2.2"

# Disabled shell for using standard output
CONFIG_NET_SHELL=n
CONFIG_SHELL=n
```

## src/main.c
```c
/*
 * Copyright (c) 2023 Golioth, Inc.
 *
 * SPDX-License-Identifier: Apache-2.0
 */

#include <zephyr/logging/log.h>
LOG_MODULE_REGISTER(fw_update_sample, LOG_LEVEL_DBG);

#include <golioth/client.h>
#include <golioth/fw_update.h>
#include <golioth/location/cellular.h>
#include <samples/common/sample_credentials.h>
#include <string.h>
#include <zephyr/kernel.h>

#include <samples/common/net_connect.h>

#include <app_version.h>

#include "cellular.h"

#define APP_TIMEOUT_S 5



// Current firmware version; update in VERSION
// Current firmware version; update in VERSION
static const char *_current_version =
    STRINGIFY(APP_VERSION_MAJOR) "." STRINGIFY(APP_VERSION_MINOR) "." STRINGIFY(APP_PATCHLEVEL);

static K_SEM_DEFINE(connected, 0, 1);

static void on_client_event(struct golioth_client *client,
                            enum golioth_client_event event,
                            void *arg)
{
    bool is_connected = (event == GOLIOTH_CLIENT_EVENT_CONNECTED);
    if (is_connected)
    {
        k_sem_give(&connected);
    }
    LOG_INF("Golioth client %s", is_connected ? "connected" : "disconnected");
}


static struct golioth_location_req location_req;

static int cellular_get_and_encode_info(void)
{
    struct golioth_cellular_info cellular_infos[4];
    enum golioth_status status;
    size_t num_infos;
    int err;

    if (!IS_ENABLED(CONFIG_GOLIOTH_LOCATION_CELLULAR))
    {
        return 0;
    }

    err = cellular_info_get(cellular_infos, ARRAY_SIZE(cellular_infos), &num_infos);
    if (err)
    {
        LOG_ERR("Failed to get cellular network info: %d", err);
        return err;
    }

LOG_INF("Cellular infos found: %d", num_infos);

    for (size_t i = 0; i < num_infos; i++)
    {
        status = golioth_location_cellular_append(&location_req, &cellular_infos[i]);
        if (status != GOLIOTH_OK)
        {
            LOG_ERR("Failed to append cellular info: %d", status);
            return -ENOMEM;
        }
    }


    return 0;
}
int main(void)
{
        struct golioth_location_rsp location_rsp;
    enum golioth_status status;
    int err;

    LOG_DBG("Start location sample");
    LOG_DBG("Start FW Update sample");

    net_connect();

    /* Note: In production, you would provision unique credentials onto each
     * device. For simplicity, we provide a utility to hardcode credentials as
     * kconfig options in the samples.
     */
    const struct golioth_client_config *client_config = golioth_sample_credentials_get();

    struct golioth_client *client = golioth_client_create(client_config);

    golioth_client_register_event_callback(client, on_client_event, NULL);

    golioth_fw_update_init(client, _current_version);

    k_sem_take(&connected, K_FOREVER);

   // send_device_data();

    /* No while(true) loop needed, the Golioth client thread will handle updates */
  while (true)
    {
        golioth_location_init(&location_req);

        err = cellular_get_and_encode_info();
        if (err)
        {
            continue;
        }

        status = golioth_location_finish(&location_req);
        if (status != GOLIOTH_OK)
        {
            if (status == GOLIOTH_ERR_NULL)
            {
                LOG_WRN("No location data to be provided");
                return 0;
            }

            LOG_ERR("Failed to encode location data");
            return -ENOMEM;
        }

        status = golioth_location_get_sync(client, &location_req, &location_rsp, APP_TIMEOUT_S);
        if (status == GOLIOTH_OK)
        {
            LOG_INF("%s%lld.%09lld %s%lld.%09lld (%lld)",
                    location_rsp.latitude < 0 ? "-" : "",
                    llabs(location_rsp.latitude) / 1000000000,
                    llabs(location_rsp.latitude) % 1000000000,
                    location_rsp.longitude < 0 ? "-" : "",
                    llabs(location_rsp.longitude) / 1000000000,
                    llabs(location_rsp.longitude) % 1000000000,
                    (long long int) location_rsp.accuracy);
        }

        k_msleep(CONFIG_APP_LOCATION_GET_INTERVAL);
    }

    return 0;
}
```
